## RTOS_robot/build/Kconfig/boards/Kconfig.defconfig
```kconfig
# Load Zephyr board defconfig descriptions.
osource "C:/ncs/v3.4.0/zephyr/boards/nordic/nrf5340_audio_dk/Kconfig.defconfig"
```

## RTOS_robot/build/Kconfig/boards/Kconfig.sysbuild.tmp
```kconfig
# Load Sysbuild board Kconfig descriptions.
osource "C:/ncs/v3.4.0/zephyr/boards/nordic/nrf5340_audio_dk/Kconfig.sysbuild"
```

## RTOS_robot/build/RTOS_robot/Kconfig/boards/Kconfig.nrf5340_audio_dk.tmp
```kconfig
# Load board Kconfig descriptions.
osource "C:/ncs/v3.4.0/zephyr/boards/nordic/nrf5340_audio_dk/Kconfig.nrf5340_audio_dk"
```
